// SpaceInvaders.c
// Runs on LM4F120/TM4C123
// Jonathan Valvano and Daniel Valvano
// This is a starter project for the EE319K Lab 10

// Last Modified: 3/6/2015 
// http://www.spaceinvaders.de/
// sounds at http://www.classicgaming.cc/classics/spaceinvaders/sounds.php
// http://www.classicgaming.cc/classics/spaceinvaders/playguide.php
/* This example accompanies the books
   "Embedded Systems: Real Time Interfacing to Arm Cortex M Microcontrollers",
   ISBN: 978-1463590154, Jonathan Valvano, copyright (c) 2014

   "Embedded Systems: Introduction to Arm Cortex M Microcontrollers",
   ISBN: 978-1469998749, Jonathan Valvano, copyright (c) 2014

 Copyright 2015 by Jonathan W. Valvano, valvano@mail.utexas.edu
    You may use, edit, run or distribute this file
    as long as the above copyright notice remains
 THIS SOFTWARE IS PROVIDED "AS IS".  NO WARRANTIES, WHETHER EXPRESS, IMPLIED
 OR STATUTORY, INCLUDING, BUT NOT LIMITED TO, IMPLIED WARRANTIES OF
 MERCHANTABILITY AND FITNESS FOR A PARTICULAR PURPOSE APPLY TO THIS SOFTWARE.
 VALVANO SHALL NOT, IN ANY CIRCUMSTANCES, BE LIABLE FOR SPECIAL, INCIDENTAL,
 OR CONSEQUENTIAL DAMAGES, FOR ANY REASON WHATSOEVER.
 For more information about my classes, my research, and my books, see
 http://users.ece.utexas.edu/~valvano/
 */
// ******* Possible Hardware I/O connections*******************
// Slide pot pin 1 connected to ground
// Slide pot pin 2 connected to PE2/AIN1
// Slide pot pin 3 connected to +3.3V 
// fire button connected to PE0
// special weapon fire button connected to PE1
// 8*R resistor DAC bit 0 on PB0 (least significant bit)
// 4*R resistor DAC bit 1 on PB1
// 2*R resistor DAC bit 2 on PB2
// 1*R resistor DAC bit 3 on PB3 (most significant bit)
// LED on PB4
// LED on PB5

// Backlight (pin 10) connected to +3.3 V
// MISO (pin 9) unconnected
// SCK (pin 8) connected to PA2 (SSI0Clk)
// MOSI (pin 7) connected to PA5 (SSI0Tx)
// TFT_CS (pin 6) connected to PA3 (SSI0Fss)
// CARD_CS (pin 5) unconnected
// Data/Command (pin 4) connected to PA6 (GPIO), high for data, low for command
// RESET (pin 3) connected to PA7 (GPIO)
// VCC (pin 2) connected to +3.3 V
// Gnd (pin 1) connected to ground

#include <stdint.h>
#include "tm4c123gh6pm.h"
#include "ST7735.h"
#include "Random.h"
#include "TExaS.h"
#include "ADC.h"
#include "Menu.h"
#include "PlayerMove.h"
#include "GameOver.h"
#include "Sound.h"
#include "Dac.h"


	extern int8_t GameMap[128][160];

	extern int16_t RedCoord[2]; //[X,Y]
	extern int8_t Red_UD;
	extern int8_t Red_LR;
	extern uint32_t Red_In[2];
	
	extern int16_t BlueCoord[2]; //[X,Y]
	extern int8_t Blue_UD;
	extern int8_t Blue_LR;
	extern uint32_t Blue_In[2];
	
	extern uint32_t RedScore;	//PlayerScores
	extern uint32_t BlueScore;
	
	extern uint16_t PCoord[2]; //[X,Y] of powerup
	
	extern uint8_t PDir[5];
	
	
	uint8_t ToxicEncountered=5;
	
	extern int8_t RedStatus; //1= normal, 0=toxic
	extern int8_t BlueStatus;

	
	extern uint8_t Collision;
	uint8_t GameMode;
	uint8_t FluteIndex=0;
	
	uint8_t GeneratePower=0;
	uint8_t Timer0Delay=100;
	uint32_t SpeedDuration=900000000;
	extern uint8_t SongState;
	
	
	
	typedef const struct Song{
		uint8_t Tempo;
		uint8_t size;
		uint8_t Repeat;
		uint16_t notes[200];
	}Stype;
	
#define C    2389   // 1046.5 Hz
#define B    2531   // 987.8 Hz
#define BF   2681   // 932.3 Hz
#define A    2841   // 880 Hz
#define AF   3010   // 830.6 Hz
#define G    3189   // 784 Hz
#define GF  3378   // 740 Hz
#define F   3579   // 698.5 Hz
#define E   3792   // 659.3 Hz
#define EF  4018   // 622.3 Hz
#define D   4257   // 587.3 Hz
#define DF  4510   // 554.4 Hz
#define C4  4778 
#define B3  5062
#define BF3 5362
#define A3  5682
#define AF3	6020
#define G3	6378
	

	Stype Song[6]={
		{9, 164, 1, {E, E, E, E, G, G, E, E, E, E, G, G, C4, C4, C4, C4, C4, C4, 0, C4, C4, A3, C4, C4, D, D, E, E, C4, C4, E, E, E, E, G, G, E, E, E, E, G, G, C4, C4, C4, C4, C4, C4, 0, C4, C4, A3, C4, C4, D, D, E, E, 0, 0, 
		C4, C4, C4, C4, F, F, A, A, A, A, A, A, A, A, G, G, G, G, E, E, C4, C4, C4, C4, C4, C4, C4, C4, F, F, F, F, E, E, B3, B3, B3, B3, B3, B3, D, D, E, E, E, E, D, D, C4, C4, C4, C4, C4, 0, 0,
		C4, C4, C4, C4, F, F, A, A, A, A, A, A, A, A, G, G, G, G, E, E, C4, C4, C4, C4, C4, C4, 0, 0, A3, A3, 0, A3, A3, 0, 0, A3, A3, C4, C4, A3, A3, G, G, G, 0, 0, 0}},	//menu
		
		{13, 20, 0, {C4, C4, E, F, G, G, B, B, C, C, C, C, C4, 1, C4, 1, 1, 1, 1}},	//game start
		
		{6, 1, 1, {1}},
		
		{6, 200, 0, {C4, C4, E, E, G, G, A, A, GF, GF, D, D, E, E, AF, AF, B, B,0,0,0,0,0,0,0,0,0,0,0,0,0}},
			
		{6, 4, 0, {C4, C4, GF, GF}},
	
		{6, 18, 0, {EF, EF, BF, BF, D, D, A, A, DF, DF, AF, AF, C4, C4, E, E, G, G, C, C, C, C }},
	};
		



	extern uint8_t MultiIndex;
	uint8_t SongDelay=9;
	
		uint16_t FallingEdges;
	

	
	uint32_t GameTimer=4100;	//allows for 60 seconds of gameplay (approx)

const unsigned short Red_Inkling_Toxic[] = {
 0x07FA, 0x07FA, 0x07FA, 0x07FA, 0x07FA, 0x07FA, 0x07FA, 0x07FA, 0x07FA, 0x07FA, 0x07FA, 0x07FA, 0x07FA, 0x07FA, 0x07FA, 0x07FA,
 0x07FA, 0x07FA, 0x07FA, 0x07FA, 0x07FA, 0x07FA, 0x07FA, 0x07FA, 0x000F, 0x000F, 0x07FA, 0x07FA, 0x07FA, 0x07FA, 0x07FA, 0x07FA,
 0x07FA, 0x07FA, 0x000F, 0x000F, 0x07FA, 0x07FA, 0x07FA, 0x07FA, 0x07FA, 0x07FA, 0x07FA, 0x000F, 0x000F, 0x000F, 0x07FA, 0x07FA,
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 0x07FA, 0x07FA, 0x07FA, 0x07FA, 0x07FA, 0x07FA, 0x07FA, 0x07FA, 0x07FA, 0x07FA, 0x07FA, 0x07FA, 0x07FA, 0x07FA, 0x07FA, 0x07FA,
};

const unsigned short Red_Inkling[] = {
 0x003F, 0x001F, 0x001F, 0x003F, 0x003F, 0x003F, 0x003F, 0x003F, 0x003F, 0x003F, 0x003F, 0x003F, 0x003F, 0x003F, 0x003F, 0x003F,
 0x003F, 0x001F, 0x003F, 0x001F, 0x001F, 0x003F, 0x001F, 0x001F, 0x000F, 0x000F, 0x001F, 0x001F, 0x001F, 0x001F, 0x003F, 0x003F,
 0x003F, 0x003F, 0x000F, 0x000F, 0x003F, 0x003F, 0x003F, 0x001F, 0x001F, 0x003F, 0x003F, 0x000F, 0x000F, 0x000F, 0x003F, 0x003F,
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 0x003F, 0x003F, 0x003F, 0x003F, 0x003F, 0x003F, 0x003F, 0x003F, 0x003F, 0x003F, 0x003F, 0x003F, 0x003F, 0x003F, 0x003F, 0x001F,
};

const unsigned short Red_Inkling_Invincible[] = {
 0x001F, 0x001F, 0x001F, 0x001F, 0x001F, 0x001F, 0x001F, 0x001F, 0x001F, 0x001F, 0x001F, 0x001F, 0x001F, 0x001F, 0x001F, 0x001F,
 0x001F, 0x001F, 0x001F, 0x001F, 0x001F, 0x001F, 0x001F, 0x001F, 0x05FF, 0x05FF, 0x001F, 0x001F, 0x001F, 0x001F, 0x001F, 0x001F,
 0x001F, 0x001F, 0x05FF, 0x05FF, 0x001F, 0x001F, 0x001F, 0x001F, 0x001F, 0x001F, 0x001F, 0x05FF, 0x05FF, 0x05FF, 0x001F, 0x001F,
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 0x001F, 0x001F, 0x001F, 0x001F, 0x001F, 0x001F, 0x001F, 0x001F, 0x001F, 0x001F, 0x001F, 0x001F, 0x001F, 0x001F, 0x001F, 0x001F,
};



const unsigned short Blue_Inkling[] = {
 0xF800, 0xF800, 0xF800, 0xF800, 0xF800, 0xF800, 0xF800, 0xF800, 0xF800, 0xF800, 0xF800, 0xF800, 0xF800, 0xF800, 0xF800, 0xF800,
 0xF800, 0xF800, 0xF800, 0xF800, 0xF800, 0xF800, 0xF800, 0xF800, 0xFFE0, 0xFFE0, 0xF800, 0xF800, 0xF800, 0xF800, 0xF800, 0xF800,
 0xF800, 0xF800, 0xFFE0, 0xFFE0, 0xF800, 0xF800, 0xF800, 0xF800, 0xF800, 0xF800, 0xF800, 0xFFE0, 0xFFE0, 0xFFE0, 0xF800, 0xF800,
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 0xF800, 0xF800, 0xF800, 0xF800, 0xF800, 0xF800, 0xF800, 0xF800, 0xF800, 0xF800, 0xF800, 0xF800, 0xF800, 0xF800, 0xF800, 0xF800,
};

const unsigned short Blue_Inkling_Toxic[] = {
 0x07F5, 0x07F5, 0x07F5, 0x07F5, 0x07F5, 0x07F5, 0x07F5, 0x07F5, 0x07F5, 0x07F5, 0x07F5, 0x07F5, 0x07F5, 0x07F5, 0x07F5, 0x07F5,
 0x07F5, 0x07F5, 0x07F5, 0x07F5, 0x07F5, 0x07F5, 0x07F5, 0x07F5, 0xFFE0, 0xFFE0, 0x07F5, 0x07F5, 0x07F5, 0x07F5, 0x07F5, 0x07F5,
 0x07F5, 0x07F5, 0xFFE0, 0xFFE0, 0x07F5, 0x07F5, 0x07F5, 0x07F5, 0x07F5, 0x07F5, 0x07F5, 0xFFE0, 0xFFE0, 0xFFE0, 0x07F5, 0x07F5,
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 0x07F5, 0x07F5, 0x07F5, 0x07F5, 0x07F5, 0x07F5, 0x07F5, 0x07F5, 0x07F5, 0x07F5, 0x07F5, 0x07F5, 0x07F5, 0x07F5, 0x07F5, 0x07F5,
};

const unsigned short Blue_Inkling_Invincible[] ={
 0xF800, 0xF800, 0xF800, 0xF800, 0xF800, 0xF800, 0xF800, 0xF800, 0xF800, 0xF800, 0xF800, 0xF800, 0xF800, 0xF800, 0xF800, 0xF800,
 0xF800, 0xF800, 0xF800, 0xF800, 0xF800, 0xF800, 0xF800, 0xF800, 0x05FF, 0x05FF, 0xF800, 0xF800, 0xF800, 0xF800, 0xF800, 0xF800,
 0xF800, 0xF800, 0x05FF, 0x05FF, 0xF800, 0xF800, 0xF800, 0xF800, 0xF800, 0xF800, 0xF800, 0x05FF, 0x05FF, 0x05FF, 0xF800, 0xF800,
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 0xF800, 0xF800, 0xF800, 0xF800, 0xF800, 0xF800, 0xF800, 0xF800, 0xF800, 0xF800, 0xF800, 0xF800, 0xF800, 0xF800, 0xF800, 0xF800,
};



const unsigned short powerup[] = {
 0x0000, 0x0000, 0x0000, 0x0000, 0x0000, 0x0000, 0x0000, 0x0000, 0x0000, 0x0000, 0x0000, 0x0000, 0x0000, 0x0000, 0x0000, 0x0000,
 0x0000, 0x0000, 0x0000, 0x0000, 0x0000, 0x0000, 0x0000, 0x0000, 0x0000, 0x0000, 0x0000, 0x0000, 0x0000, 0x0000, 0x0000, 0x0000,
 0x0000, 0x0000, 0x0000, 0x0000, 0x0000, 0x0000, 0x0000, 0x0000, 0x0000, 0x0000, 0x0000, 0x0000, 0x0000, 0x1D3C, 0x1D3C, 0x1D3C,
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 0x0000, 0x0000, 0x0000, 0x0000, 0x0000, 0x0000, 0x0000, 0x0000, 0x0000, 0x0000, 0x0000, 0x0000, 0x0000, 0x0000, 0x0000, 0x0000,
};

const unsigned short black2[] = {
 0x0843, 0x0843, 0x0843, 0x0843, 0x0843, 0x0843, 0x0843, 0x0843, 0x0843, 0x0843, 0x0843, 0x0843, 0x0843, 0x0843, 0x0843, 0x0843,
 0x0843, 0x0843, 0x0843, 0x0843, 0x0843, 0x0843, 0x0843, 0x0843, 0x0843, 0x0843, 0x0843, 0x0843, 0x0843, 0x0843, 0x0843, 0x0843,
 0x0843, 0x0843, 0x0843, 0x0843, 0x0843, 0x0843, 0x0843, 0x0843, 0x0843, 0x0843, 0x0843, 0x0843, 0x0843, 0x0843, 0x0843, 0x0843,
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 0x0843, 0x0843, 0x0843, 0x0843, 0x0843, 0x0843, 0x0843, 0x0843, 0x0843, 0x0843, 0x0843, 0x0843, 0x0843, 0x0843, 0x0843, 0x0843,
};





void DisableInterrupts(void); // Disable interrupts
void EnableInterrupts(void);  // Enable interrupts
void Delay100ms(uint32_t count); // time delay in 0.1 seconds


void PortF_Init(void){
	
	/*
	SYSCTL_RCGCGPIO_R |= 0x30;
	volatile uint8_t togle=0;
	togle++;
	GPIO_PORTF_DIR_R &= ~0x11;
	GPIO_PORTF_PUR_R |= 0x10;
	GPIO_PORTF_DEN_R |= 0x11;
	
	GPIO_PORTE_DIR_R &= ~0x02;
	GPIO_PORTE_DEN_R |= 0x02;
	*/
	SYSCTL_RCGCGPIO_R |= 0x00000020; // (a) activate clock for port F
  FallingEdges = 0;             // (b) initialize counter
  GPIO_PORTF_DIR_R &= ~0x10;    // (c) make PF4 in (built-in button)
  GPIO_PORTF_AFSEL_R &= ~0x10;  //     disable alt funct on PF4
  GPIO_PORTF_DEN_R |= 0x10;     //     enable digital I/O on PF4   
  GPIO_PORTF_PCTL_R &= ~0x000F0000; // configure PF4 as GPIO
  GPIO_PORTF_AMSEL_R = 0;       //     disable analog functionality on PF
  GPIO_PORTF_PUR_R |= 0x10;     //     enable weak pull-up on PF4
  GPIO_PORTF_IS_R &= ~0x10;     // (d) PF4 is edge-sensitive
  GPIO_PORTF_IBE_R &= ~0x10;    //     PF4 is not both edges
  GPIO_PORTF_IEV_R &= ~0x10;    //     PF4 falling edge event
  GPIO_PORTF_ICR_R = 0x10;      // (e) clear flag4
  GPIO_PORTF_IM_R |= 0x10;      // (f) arm interrupt on PF4 *** No IME bit as mentioned in Book ***
  NVIC_PRI7_R = (NVIC_PRI7_R&0xFF00FFFF)|0x00A00000; // (g) priority 5
  NVIC_EN0_R = 0x40000000;      // (h) enable interrupt 30 in NVIC
  EnableInterrupts(); 
}

void Timer0_Init(void){
  SYSCTL_RCGCTIMER_R |= 0x01;   // 0) activate TIMER0
           // user function
  TIMER0_CTL_R = 0x00000000;    // 1) disable TIMER0A during setup
  TIMER0_CFG_R = 0x00000000;    // 2) configure for 32-bit mode
  TIMER0_TAMR_R = 0x00000002;   // 3) configure for periodic mode, default down-count settings
  TIMER0_TAILR_R = 12000000;    // 4) reload value
  TIMER0_TAPR_R = 0;            // 5) bus clock resolution
  TIMER0_ICR_R = 0x00000001;    // 6) clear TIMER0A timeout flag
  TIMER0_IMR_R = 0x00000001;    // 7) arm timeout interrupt
  NVIC_PRI4_R = (NVIC_PRI4_R&0x00FFFFFF)|0x80000000; // 8) priority 4
// interrupts enabled in the main program after all devices initialized
// vector number 35, interrupt number 19
  NVIC_EN0_R = 1<<19;           // 9) enable IRQ 19 in NVIC
  TIMER0_CTL_R = 0x00000001;    // 10) enable TIMER0A
}

void Timer0A_Handler(void){
  TIMER0_ICR_R = TIMER_ICR_TATOCINT;// acknowledge TIMER0A timeout
	
	Timer0Delay--;
	GeneratePower=0;
	
	if(Timer0Delay<=15){
		if(RedStatus==5)
			RedStatus=1;
		if(BlueStatus==5)
			BlueStatus=1;
	}
	
	if(Timer0Delay<=10){
		Timer0Delay=100;
		GeneratePower=1;	
	}
}



void PortD_Init(void){
	SYSCTL_RCGCGPIO_R |= 0x08; //activate port D clock
	volatile uint8_t tofle=0;
	tofle++;
	
	GPIO_PORTD_DIR_R &= ~0x03;
	
	GPIO_PORTD_DEN_R |= 0x03;
	
}

void PortB_Init(void){
	SYSCTL_RCGCGPIO_R |= 0x02;
	volatile uint8_t Tigger=1;
	Tigger--;
	GPIO_PORTB_DIR_R |= 0x0F;
	GPIO_PORTB_DEN_R |= 0x0F;
}

void SysTick_Handler(void){
	if(FluteIndex==64)
		FluteIndex=0;
	
	DAC_Out(FluteIndex);
	FluteIndex++;
	}

void GPIOPortD_Handler(void){
	GPIO_PORTD_ICR_R = 0x03;
	
}	

void PrintSprite(void){
	
	if((RedStatus!=5) && (BlueStatus!=5))
		ST7735_DrawBitmap(PCoord[0],PCoord[1], powerup, 20, 20);
	
	 else{
		ST7735_DrawBitmap(PCoord[0],PCoord[1], black2, 20, 20); 
	 }

	 switch(RedStatus){
		 
		 case 1:
			 ST7735_DrawBitmap(RedCoord[0],RedCoord[1], Red_Inkling, 20, 20);
			 break;
		 case -1:
			 ST7735_DrawBitmap(RedCoord[0],RedCoord[1], Red_Inkling_Toxic, 20, 20);
			 break;
		 case 5:
			 ST7735_DrawBitmap(RedCoord[0],RedCoord[1], Red_Inkling_Invincible, 20, 20);
	 }
	 
	 switch(BlueStatus){
		 
		 case 2:
			 ST7735_DrawBitmap(BlueCoord[0],BlueCoord[1], Blue_Inkling, 20, 20);
			 break;
		 case -1:
			 ST7735_DrawBitmap(BlueCoord[0],BlueCoord[1], Blue_Inkling_Toxic, 20, 20);
		   break;
		 case 5:
			 ST7735_DrawBitmap(BlueCoord[0],BlueCoord[1], Blue_Inkling_Invincible, 20, 20);
	 }

	
	
	
	
	}

void GenPower(void){
	
	if(GeneratePower){
		PCoord[0]=54;
		PCoord[1]=80;
	}
}

void GetPlayerStatus(void){
	
	if(BlueStatus!=5)
		BlueStatus=2;
	
	if(RedStatus!=5)
		RedStatus=1;
	
	if((GPIO_PORTD_DATA_R&0x03) == 3)
		BlueStatus=RedStatus=-1;
	
	
	if((GPIO_PORTD_DATA_R&0x03)==1)
		RedStatus=-1;
	
	
	if((GPIO_PORTD_DATA_R&0x03)==2)
		BlueStatus=-1;
	
}





void SongPlay(uint8_t SongState){
	
	Sound_Play(Song[SongState].notes[MultiIndex]);
			
			if(SongDelay==0){
			SongDelay=Song[SongState].Tempo;
			MultiIndex++;
			}
			
			SongDelay--;
			
			if(MultiIndex==Song[SongState].size){
				MultiIndex=0;
			}
}


void GameStart(void){
	
	ST7735_SetCursor(5,8);
	ST7735_OutString("Game Start!");
	
	for(int i=160; i!=0; i--){
		SongPlay(1);
		for(int j=100000; j!=0; j--){}
	}
	
	SongState=2;
}


void MultiPlayer(void){
		ST7735_FillScreen(0x0000);
		GameStart();
		ST7735_FillScreen(0x0000);
		MultiIndex=0;
		Timer0_Init();
	
		while(1){
			SongPlay(SongState);
		
			MovementDelay();
		
			ADC89_In(Red_In);
			ADC0_In(Blue_In);
		
			Red_UD=PlayerRedY(Red_In[0]);	
			Red_LR=PlayerRedX(Red_In[1]);
		
			Blue_UD=PlayerBlueY(Blue_In[0]);
			Blue_LR=PlayerBlueX(Blue_In[1]);
		
			PlayerRedMove();	
		
			PlayerBlueMove();
			
			ToxicEncountered=CheckToxic(RedStatus, BlueStatus);
		
			UpdateMap(RedStatus, BlueStatus);
		
			PlayerDelay(ToxicEncountered, (GPIO_PORTE_DATA_R&0x02));

			GetPlayerStatus();
			
			
			PrintSprite();	//updates sprite
			
			Collision=CollideDetect();
			CollisionReset();
			GenPower();
			
			
			if(RedStatus==5 || BlueStatus==5)
				SongState=3;
			else
				SongState=2;
			
			
			if(GameTimer==1){
				for(int i=160; i!=0; i--){
		SongPlay(5);
		for(int j=100000; j!=0; j--){}
	}
				
				
			}
			GameTimer=CheckOver(GameTimer, RedScore, BlueScore);	//update GameTimer
			}
}

int main(void){
	PortF_Init();
	PortD_Init();
	PortB_Init();
	Sound_Init();
	
  TExaS_Init();  // set system clock to 80 MHz
  Random_Init(1);
	ADC0_Init();
	ADC89_Init();
  Output_Init();
  ST7735_FillScreen(0x780F);            // set screen to black
              // delay 5 sec at 80 MHz
         
	RedCoord[0]=0;
	RedCoord[1]=19;
	RedScore=0;
	
	BlueCoord[0]=108;
	BlueCoord[1]=19;
	BlueScore=0;
	
	PCoord[0]=54;
	PCoord[1]=80;
	RedStatus=1;
	BlueStatus=2;
	
	
	GameMode=Menu();
	
  if(GameMode==0)
		MultiPlayer();
}

void GPIOPortF_Handler(void){
	GPIO_PORTF_ICR_R=0x10;
	RedCoord[0]=0;
	RedCoord[1]=19;
	RedScore=0;
	
	BlueCoord[0]=108;
	BlueCoord[1]=19;
	BlueScore=0;
	
	PCoord[0]=54;
	PCoord[1]=80;
	RedStatus=1;
	BlueStatus=2;
	
	ST7735_FillScreen(0x780F);
	
	Menu();
	
}







// You can use this timer only if you learn how it works

